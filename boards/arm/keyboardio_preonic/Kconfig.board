## boards/arm/keyboardio_preonic/Kconfig.board
```kconfig
# Preonic board configuration

# Copyright (c) 2021 Pete Johanson
# SPDX-License-Identifier: MIT

config BOARD_KEYBOARDIO_PREONIC
	bool "Keyboardio Preonic"
	depends on SOC_NRF52840_QIAA
```

## boards/arm/keyboardio_preonic/Kconfig.defconfig
```kconfig
# Copyright (c) 2020 Pete Johanson
# SPDX-License-Identifier: MIT

if BOARD_KEYBOARDIO_PREONIC

config BOARD
	default "keyboardio_preonic"

config ZMK_KEYBOARD_NAME
	default "Preonic"

if USB

config USB_NRFX
	default y

config USB_DEVICE_STACK
	default y

endif # USB

config BT_CTLR
	default BT

config ZMK_BLE
	default y

config ZMK_USB
	default y

endif # BOARD_KEYBOARDIO_PREONIC
```
